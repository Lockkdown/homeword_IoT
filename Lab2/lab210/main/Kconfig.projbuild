## Lab2/lab210/main/Kconfig.projbuild
```kconfig
menu "Example Connection Configuration"
    config EXAMPLE_WIFI_SSID
        string "WiFi SSID"
        default "myssid"
        help
            SSID (network name) for the example to connect to.

    config EXAMPLE_WIFI_PASSWORD
        string "WiFi Password"
        default "mypassword"
        help
            WiFi password (WPA or WPA2) for the example to use.

    config EXAMPLE_BROKER_URL
        string "Broker URL"
        default "mqtt://192.168.1.100:1883"
        help
            URL of the MQTT broker (e.g. mqtt://192.168.1.100:1883)
endmenu
```

## LabMore/TinyFlashBang/main/Kconfig.projbuild
```kconfig
menu "Example Configuration"

    config BROKER_URL
        string "Broker URL"
        default "mqtt://192.168.1.58"
        help
            URL of the MQTT broker to connect to

    config BROKER_URL_FROM_STDIN
        bool
        default y if BROKER_URL = "FROM_STDIN"

    config LIGHT_GPIO_PIN
        int "Light GPIO Pin"
        default 5
        help
            GPIO pin number connected to the LED/light.
            Default is GPIO 5 (built-in LED on ESP32-C3-DevKitM-1).

    config LIGHT_ACTIVE_LOW
        bool "Relay active low"
        default y
        help
            Set this to enabled when the relay turns on when the GPIO output is LOW.
            Disable it if your relay turns on when the GPIO output is HIGH.

endmenu
```
